## conf/machine/mx6qwave.conf
```bitbake
#@TYPE: Machine
#@NAME: North Invent Wave Evolution
#@SOC: i.MX6Q
#@DESCRIPTION: Machine configuration for North Invent Wave Evolution
#@MAINTAINER: Masssimiliano Agneni <massimiliano.agneni@iptronix.com>

require conf/machine/include/mx6qwave-common.inc

SOC_FAMILY = "mx6:mx6q"

KERNEL_DEVICETREE = "imx6q-wave.dtb "

UBOOT_CONFIG ??= "sd"
UBOOT_CONFIG[sd] = "mx6qwave_config,sdcard"
UBOOT_CONFIG[mfgtool] = "mx6qwave_config"
```
